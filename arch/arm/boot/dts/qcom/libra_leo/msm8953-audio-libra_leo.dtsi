&int_codec {
	/delete-property/ qcom,cdc-us-euro-gpios;

	/delete-property/ asoc-wsa-codec-names;
	/delete-property/ asoc-wsa-codec-prefixes;

	/delete-property/ msm-vdd-wsa-switch-supply;
	/delete-property/ qcom,msm-vdd-wsa-switch-voltage;
	/delete-property/ qcom,msm-vdd-wsa-switch-current;
};	

/delete-node/ &slim_msm;
/delete-node/ &ext_codec;
/delete-node/ &wcd_rst_gpio;
